## config/boards/shields/Deskiny/Kconfig.defconfig
```kconfig
 CONFIG_ZMK_HID_CONSUMER_REPORT_SIZE=42
 CONFIG_ZMK_HID_REPORT_TYPE_NKRO=y
 
 if SHIELD_DESKINY_LEFT
    config ZMK_KEYBOARD_NAME
        default "DESKINY"

    config ZMK_SPLIT_ROLE_CENTRAL
        default y
endif
if SHIELD_DESKINY_LEFT || SHIELD_DESKINY_RIGHT
    config ZMK_SPLIT
        default y
endif
```
