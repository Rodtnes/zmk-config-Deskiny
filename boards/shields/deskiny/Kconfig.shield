## boards/shields/deskiny/Kconfig.shield
```kconfig
config SHIELD_DESKINY_LEFT
    def_bool $(shields_list_contains,deskiny_left)
    
config SHIELD_DESKINY_RIGHT
    def_bool $(shields_list_contains,deskiny_right)
```
